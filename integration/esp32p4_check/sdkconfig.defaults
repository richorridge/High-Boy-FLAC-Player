## integration/esp32p4_check/sdkconfig.defaults
```kconfig
# The subset of firmware_p4/sdkconfig.defaults that affects this code.
CONFIG_IDF_TARGET="esp32p4"
CONFIG_ESP_DEFAULT_CPU_FREQ_MHZ_360=y
CONFIG_COMPILER_OPTIMIZATION_PERF=y
CONFIG_SPIRAM=y
CONFIG_SPIRAM_MODE_HEX=y
CONFIG_SPIRAM_SPEED_200M=y
CONFIG_SPIRAM_USE_MALLOC=y
CONFIG_FREERTOS_HZ=1000
CONFIG_ESP_MAIN_TASK_STACK_SIZE=8192
CONFIG_LV_FONT_MONTSERRAT_12=y
CONFIG_LV_FONT_MONTSERRAT_14=y
CONFIG_LV_FONT_MONTSERRAT_16=y
CONFIG_LV_USE_CLIB_MALLOC=y
CONFIG_LV_CACHE_DEF_SIZE=1048576
CONFIG_LV_USE_LODEPNG=y
CONFIG_LV_USE_TJPGD=y
```
